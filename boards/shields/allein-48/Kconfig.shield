## boards/shields/allein-48/Kconfig.shield
```kconfig
# Copyright (c) 2020 Pete Johanson
# SPDX-License-Identifier: MIT

config SHIELD_ALLEIN
    def_bool $(shields_list_contains,allein-48)
```

## config/west.yml
```yaml
manifest:
  remotes:
    - name: zmkfirmware
      url-base: https://github.com/zmkfirmware
    - name: alleindrach
      url-base: https://github.com/alleindrach
  projects:
    - name: zmk-ps2
      remote: alleindrach
      revision: alleindrach/touch_point
      import: app/west.yml
      path: zmk
    
  self:
    path: config
```
